## boards/shields/neodoxzmk/Kconfig.defconfig
```kconfig
if SHIELD_NEODOXZMK_LEFT

config ZMK_KEYBOARD_NAME
    default "Neodox"

config ZMK_SPLIT_ROLE_CENTRAL
    default y

endif # SHIELD_NEODOXZMK_LEFT

if SHIELD_NEODOXZMK_LEFT || SHIELD_NEODOXZMK_RIGHT

config ZMK_SPLIT
    default y

endif # SHIELD_NEODOXZMK_LEFT || SHIELD_NEODOXZMK_RIGHT
```

## boards/shields/neodoxzmk/Kconfig.shield
```kconfig
config SHIELD_NEODOXZMK_LEFT
    def_bool $(shields_list_contains,neodoxzmk_left)

config SHIELD_NEODOXZMK_RIGHT
    def_bool $(shields_list_contains,neodoxzmk_right)
```
